## main/Kconfig.projbuild
```kconfig
menu "Streamer configuration"
    config USE_AS_AP
        bool "Act as access-point"
        default n
        help
            Act as accesspoint as opposed to connecting to a wifi

    config AP_SSID
        string "Access-point SSID"
        default "crazyflie"
        depends on USE_AS_AP
        help
            SSID (network name) of the access-point created in AP mode.
            Must be 1 to 31 characters -- anything else fails the build.

    config AP_PASSWORD
        string "Access-point password"
        default ""
        depends on USE_AS_AP
        help
            WPA2 password for the access-point created in AP mode.
            Leave empty for an open network, otherwise it must be 8 to 63
            characters -- anything else fails the build.

    menu "Credentials for connecting to another access-point"
        depends on !USE_AS_AP

        config EXAMPLE_SSID
            string "WiFi SSID"
            default "myssid"
            help
                SSID (network name) for the example to connect to.

        config EXAMPLE_PASSWORD
            string "WiFi Password"
            default "mypassword"
            help
                WiFi password (WPA or WPA2) for the example to use.
    endmenu

    config ENABLE_MDNS
        bool "Enable mDNS"
        default y
        help
            Allow NINA to be reached as hostname.local

    config MDNS_HOSTNAME
            string "mDNS Hostname"
            default "aideck"
            depends on ENABLE_MDNS
            help
                mDNS Hostname

    config ENABLE_UDP_TX
        bool "Use UDP for transmission (ESP->HOST)"
        default n
        help
            Reduce latency by transmitting CPX packets to host over UDP
endmenu
```
